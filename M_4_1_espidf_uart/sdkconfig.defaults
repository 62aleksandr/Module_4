## M_4_1_espidf_uart/sdkconfig.defaults
```kconfig
CONFIG_LOG_DEFAULT_LEVEL_INFO=y
CONFIG_LOG_DEFAULT_LEVEL=3

CONFIG_LOG_MAXIMUM_LEVEL_DEBUG=y
CONFIG_LOG_MAXIMUM_LEVEL=4

CONFIG_LOG_COLORS=y
```

## Module_4_7_espidf_blink/sdkconfig.defaults
```kconfig
CONFIG_LOG_DEFAULT_LEVEL_VERBOSE 1
CONFIG_LOG_DEFAULT_LEVEL 3

CONFIG_LOG_MAXIMUM_EQUALS_DEFAULT 1
CONFIG_LOG_MAXIMUM_LEVEL 3

CONFIG_LOG_COLORS=y
```
